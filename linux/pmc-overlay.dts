// Raspberry Pi device-tree overlay: pmc controller on I2C1 (GPIO2 SDA, GPIO3 SCL)
/dts-v1/;
/plugin/;

/ {
	compatible = "brcm,bcm2835";

	fragment@0 {
		target = <&i2c1>;
		__overlay__ {
			#address-cells = <1>;
			#size-cells = <0>;
			status = "okay";

			pmc@42 {
				compatible = "praveen,pmc-hwmon";
				reg = <0x42>;
			};
		};
	};
};
